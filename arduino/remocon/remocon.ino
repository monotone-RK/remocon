/******************************************************************************/
/* Remote Controller Ver 1.0                                      monotone-RK */
/*                                                    Last updated 2014.02.14 */
/******************************************************************************/

#define IR_OUTPIN  2
#define MODE_PIN   4
#define LEDPIN     8
#define IR_INPIN   7
#define LOW_STATE  0  // receiving IR signal
#define HIGH_STATE 1  // nop
#define WAITTIME   5000000  // 5sec
#define BAUDRATE   115200

void setup() {
  pinMode(MODE_PIN, INPUT);
  pinMode(IR_INPIN, INPUT);
  pinMode(IR_OUTPIN, OUTPUT);
  pinMode(LEDPIN, OUTPUT);
  Serial.begin(BAUDRATE);
}
 
/* recvSignal */
/**********************************************************/
void waitIfLow() {
  while (digitalRead(IR_INPIN) == LOW) {
    ;  // waiting
  }
}
 
void waitIfHigh() {
  while (digitalRead(IR_INPIN) == HIGH && digitalRead(MODE_PIN) == HIGH) {
    ;  // waiting 
  }  
} 

int waitByTime() {
  unsigned long start = micros();
  while (digitalRead(IR_INPIN) == HIGH && digitalRead(MODE_PIN) == HIGH) {
    if (micros() - start > WAITTIME) return 1;
  }
  return 0;
}

void recvSignal() {
  unsigned long measure_end = micros();
  unsigned long measure_start = micros();
  int state = HIGH_STATE;
  boolean recv_signal = false;
  Serial.print("Ready to receive IR signals\n");
  while (digitalRead(MODE_PIN) == HIGH) {
    if (state == LOW_STATE) {
      waitIfLow();
    } else {
      int ret = waitByTime();
      if (ret == 1 && recv_signal) {
        Serial.print("\n");
        Serial.print("END\n");        
        return;  // next turn
      } else if (ret == 1 && !recv_signal) {
        waitIfHigh();  // waiting for receiving signals
      }
    }
    measure_end = micros();  // finish measuring transmittion time
    if (!recv_signal) { 
      recv_signal = true;
    } else {
      Serial.print((measure_end - measure_start)/10, DEC); // per 10us
      Serial.print(",");
    }
    measure_start = measure_end;  // start to measure transmittion time
    if (state == HIGH_STATE) state = LOW_STATE;
    else                     state = HIGH_STATE;
  }
}

/* sendSignal */
/**********************************************************/
// air-con on
unsigned int data[] = {40,46,40,46,40,46,40,46,39,46,40,2534,348,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133,40};
// air-con off
//unsigned int data[] = {45,41,45,40,45,41,44,41,45,41,45,2528,349,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133,40};

void sendSignal() {
  int dataSize = sizeof(data) / sizeof(data[0]);
  for (int cnt = 0; cnt < dataSize; cnt++) {
    unsigned long transmittion_time = data[cnt] * 10;  // per us
    unsigned long send_start = micros();
    /* ----- IR Signal Core begin ----- */
    do {
      /* control timing for generating 38KHz carrier frequency */
      digitalWrite(IR_OUTPIN, 1 - (cnt&1));  // If cnt is even, IR_OUT is ON. If not, IR_OUT is OFF
      delayMicroseconds(8);                  
      digitalWrite(IR_OUTPIN, 0);            
      delayMicroseconds(7);
    } while (long(micros() - send_start) < transmittion_time);  // send IR signal by transmittion time
    /* ----- IR Signal Core end   ----- */
  }
}

/* main */
/**********************************************************/
void loop() {  
  if (digitalRead(MODE_PIN) == HIGH) {
    recvSignal();
  } else {
    digitalWrite(LEDPIN, HIGH);
    sendSignal();
    digitalWrite(LEDPIN, LOW);
    delay(3000);  // 3 sec
  }  
}
